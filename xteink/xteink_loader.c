/*
 * Xteink X4 App Loader implementation
 *
 * Compile as part of the ESP-IDF firmware (requires IDF_VER).
 * See xteink_loader.h for the public interface.
 *
 * Copyright (c) 2017-2025 Fabrice Bellard
 * Copyright (c) 2017-2025 Charlie Gordon
 * Xteink X4 additions: see LICENSE
 */
#include <stdio.h>
#include <stdlib.h>
#include <string.h>

#include "xteink_loader.h"
#include "xteink_hal.h"
#include "../mquickjs.h"
#include "xteink_stdlib.h"  /* generated by: make xteink_stdlib.h */

#ifdef IDF_VER
#include "esp_log.h"
#include <dirent.h>
static const char *TAG = "xteink_loader";
#endif

/* ======================================================================
 * Internal state
 * ====================================================================== */

/* Parsed app entry from the apps directory */
typedef struct {
    char name[XTEINK_APP_NAME_LEN]; /* filename without directory prefix */
    char path[XTEINK_APP_NAME_LEN + sizeof(XTEINK_APP_DIR)];
    int  is_bytecode;               /* 1 if .app, 0 if .js */
} AppEntry;

static AppEntry g_apps[XTEINK_MAX_APPS];
static int      g_app_count = 0;

/* Static JS working memory — allocated once, reused across app launches */
static uint8_t  g_js_mem[XTEINK_MEM_SIZE];

/* ======================================================================
 * Directory scan
 * ====================================================================== */

static int ends_with(const char *s, const char *suffix)
{
    size_t sl = strlen(s), xl = strlen(suffix);
    if (sl < xl) return 0;
    return strcmp(s + sl - xl, suffix) == 0;
}

static int scan_apps(void)
{
    g_app_count = 0;

#ifdef IDF_VER
    DIR *dir = opendir(XTEINK_APP_DIR);
    if (!dir) {
        ESP_LOGW(TAG, "Could not open apps directory: " XTEINK_APP_DIR);
        return 0;
    }
    struct dirent *ent;
    while ((ent = readdir(dir)) != NULL &&
           g_app_count < XTEINK_MAX_APPS) {
        const char *fname = ent->d_name;
        if (fname[0] == '.') continue;
        int is_bc = ends_with(fname, ".app");
        int is_js = ends_with(fname, ".js");
        if (!is_bc && !is_js) continue;

        AppEntry *e = &g_apps[g_app_count++];
        strncpy(e->name, fname, sizeof(e->name) - 1);
        snprintf(e->path, sizeof(e->path), "%s/%s", XTEINK_APP_DIR, fname);
        e->is_bytecode = is_bc;
    }
    closedir(dir);
#endif

    return g_app_count;
}

/* ======================================================================
 * Launcher UI
 * ====================================================================== */

#define ITEM_HEIGHT  28   /* pixels per menu row */
#define MARGIN_X     12
#define MARGIN_Y     20
#define TITLE_HEIGHT 30

static void draw_launcher(int selected, int scroll_top)
{
    hal_display_clear();

    /* Title bar */
    hal_display_set_color(XTEINK_COLOR_BLACK);
    hal_display_fill_rect(0, 0, XTEINK_DISPLAY_W, TITLE_HEIGHT);
    hal_display_set_color(XTEINK_COLOR_WHITE);
    hal_display_draw_text(MARGIN_X, 6, "Xteink X4 — App Launcher",
                          XTEINK_FONT_MEDIUM);

    hal_display_set_color(XTEINK_COLOR_BLACK);

    if (g_app_count == 0) {
        hal_display_draw_text(MARGIN_X, TITLE_HEIGHT + MARGIN_Y,
                              "No apps found in " XTEINK_APP_DIR,
                              XTEINK_FONT_SMALL);
        hal_display_draw_text(MARGIN_X, TITLE_HEIGHT + MARGIN_Y + 20,
                              "Copy .js or .app files to the apps folder.",
                              XTEINK_FONT_SMALL);
        hal_display_refresh();
        return;
    }

    int y = TITLE_HEIGHT + MARGIN_Y;
    for (int i = scroll_top;
         i < g_app_count && i < scroll_top + XTEINK_LAUNCHER_PAGE_SIZE;
         i++) {
        if (i == selected) {
            /* Highlight the selected item */
            hal_display_fill_rect(MARGIN_X - 4, y - 2,
                                  XTEINK_DISPLAY_W - 2 * (MARGIN_X - 4),
                                  ITEM_HEIGHT - 2);
            hal_display_set_color(XTEINK_COLOR_WHITE);
        }
        hal_display_draw_text(MARGIN_X, y + 4, g_apps[i].name,
                              XTEINK_FONT_MEDIUM);
        if (i == selected)
            hal_display_set_color(XTEINK_COLOR_BLACK);
        y += ITEM_HEIGHT;
    }

    /* Scroll hint */
    if (scroll_top > 0)
        hal_display_draw_text(XTEINK_DISPLAY_W - 20, TITLE_HEIGHT + 4,
                              "^", XTEINK_FONT_SMALL);
    if (scroll_top + XTEINK_LAUNCHER_PAGE_SIZE < g_app_count)
        hal_display_draw_text(XTEINK_DISPLAY_W - 20,
                              XTEINK_DISPLAY_H - 20,
                              "v", XTEINK_FONT_SMALL);

    hal_display_refresh();
}

/* ======================================================================
 * Error display
 * ====================================================================== */

static void show_error(const char *title, const char *message)
{
    hal_display_clear();
    hal_display_set_color(XTEINK_COLOR_BLACK);
    hal_display_fill_rect(0, 0, XTEINK_DISPLAY_W, TITLE_HEIGHT);
    hal_display_set_color(XTEINK_COLOR_WHITE);
    hal_display_draw_text(MARGIN_X, 6, title, XTEINK_FONT_MEDIUM);
    hal_display_set_color(XTEINK_COLOR_BLACK);

    /* Wrap the message at ~55 chars per line */
    const int MAX_LINE = 55;
    int y = TITLE_HEIGHT + MARGIN_Y;
    const char *p = message;
    char line[MAX_LINE + 1];
    while (*p && y < XTEINK_DISPLAY_H - XTEINK_FONT_SMALL) {
        int n = 0;
        while (n < MAX_LINE && *p && *p != '\n') {
            line[n++] = *p++;
        }
        if (*p == '\n') p++;
        line[n] = '\0';
        hal_display_draw_text(MARGIN_X, y, line, XTEINK_FONT_SMALL);
        y += XTEINK_FONT_SMALL + 4;
    }
    hal_display_draw_text(MARGIN_X, XTEINK_DISPLAY_H - 22,
                          "Press any key to continue.", XTEINK_FONT_SMALL);
    hal_display_refresh();
    hal_input_wait_key();
}

/* ======================================================================
 * App execution
 * ====================================================================== */

/*
 * Load a raw file into a heap buffer.
 * Returns NULL if the file is missing or larger than XTEINK_MAX_SCRIPT_SIZE.
 * The caller is responsible for free()ing the returned buffer.
 */
static uint8_t *load_app_file(const char *path, int *out_len)
{
    FILE *f = fopen(path, "rb");
    if (!f) return NULL;

    fseek(f, 0, SEEK_END);
    long sz = ftell(f);
    fseek(f, 0, SEEK_SET);

    if (sz <= 0 || (unsigned long)sz > XTEINK_MAX_SCRIPT_SIZE) {
        fclose(f);
        return NULL;
    }

    uint8_t *buf = (uint8_t *)malloc((size_t)sz + 1);
    if (!buf) { fclose(f); return NULL; }

    fread(buf, 1, (size_t)sz, f);
    buf[sz] = '\0';
    fclose(f);
    *out_len = (int)sz;
    return buf;
}

/*
 * Run one app.  Returns 0 on success, non-zero on error.
 * Uses the static g_js_mem buffer so no heap is consumed for the
 * JS context.
 */
static int run_app(const AppEntry *app)
{
    JSContext *ctx;
    JSValue val;
    int ret = 0;

    ctx = JS_NewContext(g_js_mem, XTEINK_MEM_SIZE, &js_stdlib);
    if (!ctx) {
        show_error("Fatal", "Could not create JS context (out of memory).");
        return 1;
    }

#ifdef IDF_VER
    /* Redirect JS engine log output to UART */
    extern void xteink_js_log_func(void *opaque, const void *buf, size_t len);
    JS_SetLogFunc(ctx, xteink_js_log_func);
#endif

    if (app->is_bytecode) {
        /* ---- Load .app (pre-compiled bytecode) ---- */
        int buf_len;
        uint8_t *buf = load_app_file(app->path, &buf_len);
        if (!buf) {
            show_error("Load Error",
                       "Could not load app file.\n"
                       "File missing or exceeds 32 KB limit.");
            JS_FreeContext(ctx);
            return 1;
        }
        if (!JS_IsBytecode(buf, (size_t)buf_len)) {
            free(buf);
            show_error("Load Error", "File is not valid MQuickJS bytecode.\n"
                       "Recompile with: mqjs --xteink -o app.app script.js");
            JS_FreeContext(ctx);
            return 1;
        }
        if (JS_RelocateBytecode(ctx, buf, (uint32_t)buf_len)) {
            free(buf);
            show_error("Load Error", "Bytecode relocation failed.");
            JS_FreeContext(ctx);
            return 1;
        }
        val = JS_LoadBytecode(ctx, buf);
        /* Free the file buffer before running to maximise working memory */
        free(buf);

    } else {
        /* ---- Load .js (raw JavaScript source) ---- */
        int buf_len;
        uint8_t *src = load_app_file(app->path, &buf_len);
        if (!src) {
            show_error("Load Error",
                       "Could not load script.\n"
                       "File missing or exceeds 32 KB limit.");
            JS_FreeContext(ctx);
            return 1;
        }
        val = JS_Parse(ctx, (const char *)src, (size_t)buf_len,
                       app->name, JS_EVAL_STRIP_COL);
        free(src);
    }

    if (JS_IsException(val)) {
        JSValue exc = JS_GetException(ctx);
        JSCStringBuf msg_buf;
        const char *msg = JS_ToCString(ctx, exc, &msg_buf);
        show_error("Script Error", msg ? msg : "(unknown error)");
        JS_FreeContext(ctx);
        return 1;
    }

    val = JS_Run(ctx, val);

    if (JS_IsException(val)) {
        JSValue exc = JS_GetException(ctx);
        JSCStringBuf msg_buf, stack_buf;
        JSValue stack_val = JS_GetPropertyStr(ctx, exc, "stack");
        const char *msg   = JS_ToCString(ctx, exc, &msg_buf);
        const char *stack = JS_IsString(ctx, stack_val)
                          ? JS_ToCString(ctx, stack_val, &stack_buf)
                          : NULL;
        /* Concatenate message + stack into a single display buffer */
        char err_text[256];
        snprintf(err_text, sizeof(err_text), "%s\n%s",
                 msg   ? msg   : "(no message)",
                 stack ? stack : "");
        show_error("Runtime Error", err_text);
        ret = 1;
    }

    JS_FreeContext(ctx);
    return ret;
}

/* ======================================================================
 * Launcher loop
 * ====================================================================== */

void xteink_run_launcher(void)
{
    int selected   = 0;
    int scroll_top = 0;
    int needs_redraw = 1;

    for (;;) {
        /* Rescan the directory every time we return to the launcher so
         * newly added apps are picked up without a reboot. */
        if (needs_redraw) {
            scan_apps();
            if (g_app_count == 0) {
                selected = 0;
            } else if (selected >= g_app_count) {
                selected = g_app_count - 1;
            }
            draw_launcher(selected, scroll_top);
            needs_redraw = 0;
        }

        int key = hal_input_wait_key();
        switch (key) {
        case XTEINK_KEY_UP:
            if (selected > 0) {
                selected--;
                if (selected < scroll_top)
                    scroll_top = selected;
                needs_redraw = 1;
            }
            break;

        case XTEINK_KEY_DOWN:
            if (selected < g_app_count - 1) {
                selected++;
                if (selected >= scroll_top + XTEINK_LAUNCHER_PAGE_SIZE)
                    scroll_top = selected - XTEINK_LAUNCHER_PAGE_SIZE + 1;
                needs_redraw = 1;
            }
            break;

        case XTEINK_KEY_OK:
            if (g_app_count > 0) {
                run_app(&g_apps[selected]);
                needs_redraw = 1; /* redraw launcher after app exits */
            }
            break;

        case XTEINK_KEY_BACK:
            /* Already at top level — do nothing (or show a menu later) */
            break;

        case XTEINK_KEY_POWER:
            /* Light sleep to save battery; wake on any button press */
#ifdef IDF_VER
            esp_light_sleep_start();
#endif
            needs_redraw = 1;
            break;

        default:
            break;
        }
    }
}

/* ======================================================================
 * Log forwarding (UART)
 * ====================================================================== */

#ifdef IDF_VER
void xteink_js_log_func(void *opaque, const void *buf, size_t len)
{
    (void)opaque;
    ESP_LOGI(TAG, "%.*s", (int)len, (const char *)buf);
}
#endif
